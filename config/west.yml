## config/west.yml
```yaml
manifest:
  remotes:
    - name: zmkfirmware
      url-base: https://github.com/zmkfirmware
    - name: urob
      url-base: https://github.com/urob
    - name: infused-kim
      url-base: https://github.com/infused-kim
    - name: joelspadin
      url-base: https://github.com/joelspadin
    - name: dsifry #bongo cat
      url-base: https://github.com/dsifry
  projects:
    - name: zmk
      remote: infused-kim
      revision: urob/mouse
      import: app/west.yml
    - name: zmk-locales
      remote: joelspadin
      revision: main
    - name: nice-view-mod #bongo cat
      remote: dsifry
      revision: main
  self:
    path: config
```
