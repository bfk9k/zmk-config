#define COMBO_TERM_FAST 35
#define COMBO_TERM_SLOW 35
#define COMBO_PRIOR_IDLE 100

/ {
  combos {
    compatible = "zmk,combos";

    // combo_escape {
    //  timeout-ms = <COMBO_TERM_SLOW>;
    //  require-prior-idle-ms = <COMBO_PRIOR_IDLE>;
    //  key-positions = <LT5 LT4>;
    //  layers = <BASE NUM NAV>;
    //  bindings = <&kp ESC>;
    // };

    combo_sharp_s {
      timeout-ms = <COMBO_TERM_SLOW>;
      require-prior-idle-ms = <COMBO_PRIOR_IDLE>;
      key-positions = <RT4 RT5>;
      layers = <BASE>;
      bindings = <&kp DE_SZ>;
    };

  };
};
